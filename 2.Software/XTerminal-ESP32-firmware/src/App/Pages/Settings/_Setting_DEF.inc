SET_DEF2(System);
// SET_DEF(LV_SYMBOL_USB,GetWeatherInfo);
// SET_DEF(LV_SYMBOL_BATTERY_FULL,GetClockFromWeb);
SET_DEF(LV_SYMBOL_BATTERY_FULL,RestartDevice);
SET_DEF(LV_SYMBOL_AUDIO,RestoreConfig);
// SET_DEF(LV_SYMBOL_SHUFFLE,CalibrateIMU);
SET_DEF(LV_SYMBOL_HOME,ExitThisApp);

SET_DEF2(Config);
SET_DEF(LV_SYMBOL_UPLOAD,ModifyBlackLight);
SET_DEF(LV_SYMBOL_SAVE,ModifyWifiName);
SET_DEF(LV_SYMBOL_EDIT,ModifyWifiPasswd);
// SET_DEF3(LV_SYMBOL_OK,EnDataUpload);

SET_DEF2(Action);
SET_DEF(LV_SYMBOL_POWER,ReconnectWifi);
// SET_DEF(LV_SYMBOL_REFRESH,RemountSDcard);
// SET_DEF(LV_SYMBOL_EYE_OPEN,WifiSmarConfig);
// SET_DEF(LV_SYMBOL_SETTINGS,UrlUpdateInterval)
// SET_DEF3(LV_SYMBOL_SETTINGS,Enable)
